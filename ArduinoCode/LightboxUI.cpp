//#### GENERATED BY CODEX ####
//#### GENERATED BY CODEX ####
//#### GENERATED BY CODEX ####
//#### VERIFIED BY HUMAN ####
//#### VERIFIED BY HUMAN ####
//#### VERIFIED BY HUMAN ####

#include "LightboxUI.h"
#include "Variables.h"

#include <Arduino.h>
#include <ArduinoJson.h>
#include <DNSServer.h>
#include <ESPUI.h>
#include <HTTPClient.h>
#include <HTTPUpdate.h>
#include <WiFi.h>
#include <WiFiClientSecure.h>
#include <esp_arduino_version.h>

#include "Config.h"

bool xStartOTAHotspot = false;
bool xOTAActive = false;

namespace {

constexpr char ACCESS_POINT_NAME[] = "Very Cool Lightbox";
constexpr char ACCESS_POINT_PASSWORD[] = "madewithlove";
constexpr uint8_t DNS_PORT = 53;
constexpr uint8_t MAX_WIFI_NETWORKS = 15;
constexpr uint32_t WIFI_CONNECT_TIMEOUT_MS = 20000UL;
constexpr uint32_t PORTAL_INACTIVITY_TIMEOUT_MS = 5UL * 60UL * 1000UL;
constexpr uint32_t RESTART_DELAY_MS = 3000UL;
constexpr size_t MAX_MANIFEST_SIZE = 4096;

const IPAddress ACCESS_POINT_IP(192, 168, 4, 1);
const IPAddress ACCESS_POINT_NETMASK(255, 255, 255, 0);

enum class OTAState : uint8_t {
  Inactive,
  Ready,
  Connecting,
  Updating,
  RestartPending
};

DNSServer dnsServer;
OTAState otaState = OTAState::Inactive;
String scannedNetworks[MAX_WIFI_NETWORKS];
uint8_t scannedNetworkCount = 0;
String selectedNetwork;
String selectedPassword;
bool updateRequested = false;
bool portalInitialized = false;
uint32_t wifiConnectStartedAt = 0;
uint32_t lastPortalActivityAt = 0;
uint32_t restartAt = 0;
int lastProgress = -1;

uint16_t networkControl = 0;
uint16_t passwordControl = 0;
uint16_t updateButtonControl = 0;
uint16_t statusControl = 0;
uint16_t progressControl = 0;

void touchPortalActivity() {
  lastPortalActivityAt = millis();
}

void setStatus(const String& status) {
  if (statusControl != 0) {
    ESPUI.updateLabel(statusControl, status);
  }
}

void setProgress(int progress) {
  progress = constrain(progress, 0, 100);
  if (progress == lastProgress) {
    return;
  }

  lastProgress = progress;
  if (progressControl != 0) {
    ESPUI.updateGauge(progressControl, progress, -1);
  }
}

void networkCallback(Control* sender, int) {
  touchPortalActivity();
  selectedNetwork = sender->value;
  selectedPassword = "";
  WiFi.disconnect(false, false);
  ESPUI.updateText(passwordControl, "");
  setStatus("Bitte WLAN Passwort eingeben");
}

void passwordCallback(Control* sender, int) {
  touchPortalActivity();
  selectedPassword = sender->value;
  setStatus(selectedPassword.isEmpty() ? "WLAN Passwortfeld ist leer"
                                       : "Bereit zum Starten des Updates");
}

void updateButtonCallback(Control*, int eventType) {
  touchPortalActivity();
  if (eventType == B_UP && otaState == OTAState::Ready) {
    updateRequested = true;
  }
}

bool networkAlreadyListed(const String& ssid) {
  for (uint8_t index = 0; index < scannedNetworkCount; ++index) {
    if (scannedNetworks[index] == ssid) {
      return true;
    }
  }
  return false;
}

void scanForNetworks() {
  scannedNetworkCount = 0;
  int networkCount = WiFi.scanNetworks();

  if (networkCount <= 0) {
    WiFi.scanDelete();
    return;
  }

  for (int index = 0;
       index < networkCount && scannedNetworkCount < MAX_WIFI_NETWORKS;
       ++index) {
    String ssid = WiFi.SSID(index);
    if (ssid.isEmpty() || networkAlreadyListed(ssid)) {
      continue;
    }

    scannedNetworks[scannedNetworkCount] = ssid;
    ++scannedNetworkCount;
  }

  WiFi.scanDelete();
}

void buildPortal() {
  uint16_t otaTab = ESPUI.addControl(ControlType::Tab, "OTA Update",
                                     "OTA Update");

  uint16_t versionLabel = ESPUI.addControl(
      ControlType::Label, "Installierte Version",
      String(NAME_VERSION) + " " + FW_VERSION,
      ControlColor::Wetasphalt, otaTab);
  ESPUI.setPanelWide(versionLabel, true);

  networkControl = ESPUI.addControl(
      ControlType::Select, "WLAN auswaehlen",
      scannedNetworkCount > 0 ? scannedNetworks[0] : "",
      ControlColor::Peterriver, otaTab, networkCallback);
  ESPUI.setPanelWide(networkControl, true);

  if (scannedNetworkCount == 0) {
    ESPUI.addControl(ControlType::Option, "Keine WLANs gefunden", "",
                     ControlColor::Peterriver, networkControl);
  } else {
    selectedNetwork = scannedNetworks[0];
    for (uint8_t index = 0; index < scannedNetworkCount; ++index) {
      ESPUI.addControl(ControlType::Option,
                       scannedNetworks[index].c_str(),
                       scannedNetworks[index], ControlColor::Peterriver,
                       networkControl);
    }
  }

  passwordControl = ESPUI.addControl(
      ControlType::Text, "WLAN Passwort", "", ControlColor::Peterriver,
      otaTab, passwordCallback);
  ESPUI.setInputType(passwordControl, "password");
  ESPUI.setPanelWide(passwordControl, true);

  updateButtonControl = ESPUI.addControl(
      ControlType::Button, "Firmware von GitHub laden", "Update starten",
      ControlColor::Sunflower, otaTab, updateButtonCallback);
  ESPUI.setPanelWide(updateButtonControl, true);

  statusControl = ESPUI.addControl(
      ControlType::Label, "Status", "Bereit", ControlColor::Wetasphalt,
      otaTab);
  ESPUI.setPanelWide(statusControl, true);

}

void startOTAPortal() {
  WiFi.mode(WIFI_AP_STA);
  delay(100);
  WiFi.softAPConfig(ACCESS_POINT_IP, ACCESS_POINT_IP,
                    ACCESS_POINT_NETMASK);

  if (!WiFi.softAP(ACCESS_POINT_NAME, ACCESS_POINT_PASSWORD)) {
    WiFi.mode(WIFI_OFF);
    return;
  }

  dnsServer.start(DNS_PORT, "*", ACCESS_POINT_IP);

  if (!portalInitialized) {
    scanForNetworks();
    buildPortal();
    ESPUI.captivePortal = true;
    ESPUI.begin("Very Cool Lightbox OTA");
    portalInitialized = true;
  } else {
    ESPUI.setEnabled(updateButtonControl, true);
    ESPUI.updateText(passwordControl, "");
    setStatus("Bereit");
  }

  otaState = OTAState::Ready;
  updateRequested = false;
  selectedPassword = "";
  touchPortalActivity();
}

void stopOTAPortal() {
  dnsServer.stop();
  WiFi.disconnect(false, false);
  WiFi.softAPdisconnect(true);
  WiFi.mode(WIFI_OFF);

  selectedPassword = "";
  updateRequested = false;
  otaState = OTAState::Inactive;
}

void enableRetry(const String& errorMessage) {
  otaState = OTAState::Ready;
  updateRequested = false;
  touchPortalActivity();
  ESPUI.setEnabled(updateButtonControl, true);
  setStatus(errorMessage);
}

void beginWifiConnection() {
  if (selectedNetwork.isEmpty()) {
    enableRetry("Fehler: Bitte ein WLAN auswaehlen");
    return;
  }

  if (selectedPassword.isEmpty()) {
    enableRetry("Fehler: WLAN Passwortfeld ist leer");
    return;
  }

  updateRequested = false;
  otaState = OTAState::Connecting;
  wifiConnectStartedAt = millis();
  setProgress(0);
  ESPUI.setEnabled(updateButtonControl, false);
  setStatus("Verbinde mit " + selectedNetwork + " ...");

  WiFi.disconnect(false, false);
  WiFi.begin(selectedNetwork.c_str(), selectedPassword.c_str());
}

String manifestString(JsonDocument& manifest, const char* firstKey,
                      const char* secondKey = nullptr,
                      const char* thirdKey = nullptr) {
  const char* value = manifest[firstKey] | "";
  if (value[0] == '\0' && secondKey != nullptr) {
    value = manifest[secondKey] | "";
  }
  if (value[0] == '\0' && thirdKey != nullptr) {
    value = manifest[thirdKey] | "";
  }
  return String(value);
}

bool loadManifest(String& firmwareUrl, String& firmwareVersion,
                  String& firmwareName, String& firmwareMd5) {
  setStatus("Lade Update-Informationen von GitHub ...");

  WiFiClientSecure manifestClient;
  manifestClient.setInsecure();

  HTTPClient manifestRequest;
  manifestRequest.setConnectTimeout(10000);
  manifestRequest.setTimeout(15000);
  manifestRequest.setFollowRedirects(HTTPC_STRICT_FOLLOW_REDIRECTS);

  if (!manifestRequest.begin(manifestClient, OTA_MANIFEST_URL)) {
    setStatus("Fehler: Manifest-URL konnte nicht geoeffnet werden");
    return false;
  }

  int responseCode = manifestRequest.GET();
  if (responseCode != HTTP_CODE_OK) {
    String message = "Fehler: Manifest HTTP " + String(responseCode);
    manifestRequest.end();
    setStatus(message);
    return false;
  }

  int manifestSize = manifestRequest.getSize();
  if (manifestSize > static_cast<int>(MAX_MANIFEST_SIZE)) {
    manifestRequest.end();
    setStatus("Fehler: Update-Manifest ist zu gross");
    return false;
  }

  String payload = manifestRequest.getString();
  manifestRequest.end();

  if (payload.length() == 0 || payload.length() > MAX_MANIFEST_SIZE) {
    setStatus("Fehler: Update-Manifest ist leer oder zu gross");
    return false;
  }

#if ARDUINOJSON_VERSION_MAJOR >= 7
  JsonDocument manifest;
#else
  StaticJsonDocument<1536> manifest;
#endif
  DeserializationError jsonError = deserializeJson(manifest, payload);
  if (jsonError) {
    setStatus("Fehler: Update-Manifest ist kein gueltiges JSON");
    return false;
  }

  firmwareUrl = manifestString(manifest, "url", "firmware_url", "firmware");
  firmwareVersion = manifestString(manifest, "version");
  firmwareName = manifestString(manifest, "name", "name_version",
                                "version_name");
  firmwareMd5 = manifestString(manifest, "md5");

  if (firmwareVersion.isEmpty() || firmwareName.isEmpty()) {
    setStatus("Fehler: Versionsnummer oder Versionsname fehlt im Manifest");
    return false;
  }

  if (!firmwareUrl.startsWith("https://") &&
      !firmwareUrl.startsWith("http://")) {
    setStatus("Fehler: Keine gueltige Firmware-URL im Manifest");
    return false;
  }

  return true;
}

void updateStarted() {
  lastProgress = -1;
  setProgress(0);
  setStatus("Update laeuft: 0 %");
}

void updateProgress(int currentBytes, int totalBytes) {
  if (totalBytes <= 0) {
    return;
  }

  int progress = static_cast<int>(
      (static_cast<uint64_t>(currentBytes) * 100ULL) /
      static_cast<uint32_t>(totalBytes));
  if (progress != lastProgress) {
    setProgress(progress);
    setStatus("Update laeuft: " + String(progress) + " %");
  }
}

void updateFinished() {
  setProgress(100);
}

void performFirmwareUpdate() {
  otaState = OTAState::Updating;

  String firmwareUrl;
  String firmwareVersion;
  String firmwareName;
  String firmwareMd5;
  if (!loadManifest(firmwareUrl, firmwareVersion, firmwareName,
                    firmwareMd5)) {
    otaState = OTAState::Ready;
    touchPortalActivity();
    ESPUI.setEnabled(updateButtonControl, true);
    return;
  }

  if (firmwareVersion == FW_VERSION || firmwareName == NAME_VERSION) {
    enableRetry(
        "Kein Update: Versionsnummer und Versionsname muessen neu sein");
    return;
  }

  setStatus("Starte Update auf " + firmwareName + " " +
            firmwareVersion + " ...");

  WiFiClientSecure updateClient;
  updateClient.setInsecure();

  httpUpdate.rebootOnUpdate(false);
  httpUpdate.setFollowRedirects(HTTPC_STRICT_FOLLOW_REDIRECTS);
#if ESP_ARDUINO_VERSION_MAJOR >= 3
  httpUpdate.setMD5sum(firmwareMd5);
#else
  (void)firmwareMd5;
#endif
  httpUpdate.onStart(updateStarted);
  httpUpdate.onProgress(updateProgress);
  httpUpdate.onEnd(updateFinished);

  t_httpUpdate_return result =
      httpUpdate.update(updateClient, firmwareUrl, FW_VERSION);

  if (result == HTTP_UPDATE_OK) {
    setProgress(100);
    setStatus("Update erfolgreich - Neustart in 3 Sekunden");
    otaState = OTAState::RestartPending;
    restartAt = millis();
    return;
  }

  if (result == HTTP_UPDATE_NO_UPDATES) {
    enableRetry("Kein neues Update vorhanden");
    return;
  }

  enableRetry("Update fehlgeschlagen: " + httpUpdate.getLastErrorString());
}

void processOTAState() {
  if (otaState == OTAState::Ready && updateRequested) {
    beginWifiConnection();
    return;
  }

  if (otaState == OTAState::Connecting) {
    if (WiFi.status() == WL_CONNECTED) {
      setStatus("WLAN verbunden - starte Update");
      performFirmwareUpdate();
      return;
    }

    if (static_cast<uint32_t>(millis() - wifiConnectStartedAt) >=
      WIFI_CONNECT_TIMEOUT_MS) {
      WiFi.disconnect(false, false);
      enableRetry("Fehler: WLAN Passwort falsch oder Verbindung fehlgeschlagen");
    }
    return;
  }

  if (otaState == OTAState::RestartPending &&
      static_cast<uint32_t>(millis() - restartAt) >= RESTART_DELAY_MS) {
    ESP.restart();
  }
}

void processPortalInactivity() {
  if (otaState != OTAState::Ready) {
    return;
  }

  if (static_cast<uint32_t>(millis() - lastPortalActivityAt) >=
      PORTAL_INACTIVITY_TIMEOUT_MS) {
    stopOTAPortal();
  }
}

}  // namespace

void LightboxUISetup() {
  // The OTA portal is intentionally inactive until xStartOTAHotspot is set.
}

void LightboxUILoop() {
  xOTAActive = (otaState != OTAState::Inactive);
  Global.xOTAActive = xOTAActive;
  if (xStartOTAHotspot) {
    xStartOTAHotspot = false;
    if (otaState == OTAState::Inactive) {
      startOTAPortal();
    } else {
      touchPortalActivity();
    }
  }

  if (otaState == OTAState::Inactive) {
    return;
  }

  dnsServer.processNextRequest();
  processOTAState();
  processPortalInactivity();
}
